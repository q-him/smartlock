## components/inputs/Kconfig.projbuild
```kconfig
menu "Digital inputs configuration"
    config CLOSE_DETECTOR_PIN
        int "Close detector pin"
        range 0 33
        default 33
    config REGISTER_BUTTON_PIN
        int "Register button pin"
        range 0 33
        default 32
endmenu
```

## components/lcd/Kconfig.projbuild
```kconfig
menu "LCD configuration"
    config I2C_SDA_PIN
        int "I2C SDA pin"
        range 0 34
        default 18
        
    config I2C_SCL_PIN
        int "I2C SCL pin"
        range 0 34
        default 19
            
    config LCD_I2C_ADDR
        hex "LCD I2C address"
        default 0x3F
endmenu
```

## components/lock_controller/Kconfig.projbuild
```kconfig
menu "Smartlock configuration"
    config KEY_STORAGE_SIZE
        int "Key storage size"
        range 0 1000
        default 16
        help
            Maximum amount of unlock keys stored in memory
    config MESSAGE_DELAY_MS
        int "Message delay (in ms)"
        range 0 5000
        default 1000
        help
            A period of time when message is shown and thread is paused
endmenu
```

## components/rfid/Kconfig.projbuild
```kconfig
menu "RFID configuration"
    config SPI_MOSI_PIN
        int "SPI MOSI pin"
        range 0 34
        default 19
        
    config SPI_MISO_PIN
        int "SPI MISO pin"
        range 0 34
        default 21
    
    config SPI_SDA_PIN
        int "SPI SDA pin"
        range 0 34
        default 5
    
    config SPI_SCK_PIN
        int "SPI SDK pin"
        range 0 34
        default 18
endmenu
```

## components/servo_lock/Kconfig.projbuild
```kconfig
menu "Servo lock configuration"
    config SERVO_PIN
        int "Servomotor pin"
        range 0 34
        default 32
        
    config SERVO_MIN_PULSEWIDTH_US
        int "Servo minimal pulse width"
        range 0 5000
        default 1000
    
    config SERVO_MAX_PULSEWIDTH_US
        int "Servo maximal pulse width"
        range 0 5000
        default 2000
    
    config SERVO_FREQUENCY
        int "Servo operation frequency"
        range 1 100
        default 50
endmenu
```
